## layers/meta-laptimer/conf/distro/laptimer-os.conf
```bitbake
DISTRO_NAME = "FPVLaptimerOS"

DISTRO_FEATURES = " xattr wifi opengl "

SDK_NAME = "SDK"

SDK_VERSION = "${DISTRO_VERSION}-linux"

SDK_TITLE = "FPVLaptimerOS SDK for Linux"
```

## layers/meta-laptimer/conf/layer.conf
```bitbake
# We have a conf and classes directory, add to BBPATH
BBPATH .= ":${LAYERDIR}"

# We have recipes-* directories, add to BBFILES
BBFILES += "${LAYERDIR}/recipes-images/*.bb \
            ${LAYERDIR}/recipes-images/*.bbappend"

BBFILES += "${LAYERDIR}/recipes*/*/*.bb \
            ${LAYERDIR}/recipes*/*/*.bbappend"

BBFILE_COLLECTIONS += "meta-laptimer"
BBFILE_PATTERN_meta-laptimer = "^${LAYERDIR}/"
BBFILE_PRIORITY_meta-laptimer = "11"

LAYERDEPENDS_meta-laptimer = "core"
LAYERSERIES_COMPAT_meta-laptimer = "kirkstone"

KERNEL_MODULE_AUTOLOAD:append = " i2c-dev "

## Define hostname
hostname_pn-base-files = "fpv-laptimer"

# these comes from the meta-rasberry
# turn on ttyAMA0
ENABLE_UART = "1"
ENABLE_I2C = "1"

# turn off bt because the propeller needs that serial port
RPI_EXTRA_CONFIG:append = "dtoverlay=pi3-disable-bt\n"

# preempt_rt kernel
PREFERRED_PROVIDER:virtual/kernel="linux-raspberrypi-rt"

# add SPI overlay
ENABLE_SPI_BUS = "1"
KERNEL_MODULE_AUTOLOAD:append = " spidev "

# remove serial console
SERIAL_CONSOLES = "115200;AMA0"
```
